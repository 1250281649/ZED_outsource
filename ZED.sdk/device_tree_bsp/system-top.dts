/*
 * CAUTION: This file is automatically generated by Xilinx.
 * Version:  
 * Today is: Sat Mar 31 18:34:46 2018
 */


/dts-v1/;
/include/ "zynq-7000.dtsi"
/include/ "pl.dtsi"
/include/ "pcw.dtsi"
/ {
	chosen {
		bootargs = "earlycon";
		stdout-path = "serial0:115200n8";
	};
	aliases {
		ethernet0 = &gem0;
		serial0 = &uart1;
		serial1 = &axi_uart16550_1;
		serial10 = &uart0;
		serial11 = &axi_uart16550_0;
		serial2 = &axi_uart16550_2;
		serial3 = &axi_uart16550_3;
		serial4 = &axi_uart16550_4;
		serial5 = &axi_uart16550_5;
		serial6 = &axi_uart16550_6;
		serial7 = &axi_uart16550_7;
		serial8 = &axi_uart16550_8;
		serial9 = &axi_uart16550_9;
		spi0 = &qspi;
	};
	memory {
		device_type = "memory";
		reg = <0x0 0x20000000>;
	};
};
